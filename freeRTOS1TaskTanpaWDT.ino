#include <SPI.h>
#include <LiquidCrystal_I2C.h>  
#include <Wire.h>
#include <Adafruit_GFX.h>
#include <Adafruit_SSD1306.h>
#include "SoftwareSerial.h"
#include "DFRobotDFPlayerMini.h"
#include "freertos/FreeRTOS.h"
#include "freertos/task.h"

static const uint8_t PIN_MP3_TX = 26;
static const uint8_t PIN_MP3_RX = 27;

#define AOUT_PIN 34 
#define pushButton 4
#define ledRed 5
#define ledGreen 13
#define relay 2
#define buzzer 33

#define SCREEN_WIDTH 128 
#define SCREEN_HEIGHT 64
#define OLED_RESET     -1
Adafruit_SSD1306 display(SCREEN_WIDTH, SCREEN_HEIGHT, &Wire, OLED_RESET);

int buttonState = HIGH;

LiquidCrystal_I2C lcd(0x27, 16, 2);

int airValue = 3100;
int waterValue = 2100;
int intervals = 60;
int moistureValue = 0;
unsigned long previousMillis = 0;
const long intervalBtn = 500; // Interval in milliseconds
const long intervalSoil = 1000;

 SoftwareSerial softwareSerial(PIN_MP3_RX, PIN_MP3_TX);
 DFRobotDFPlayerMini player;

int lastPlayedTrack = -1; // Track the last played track

#define FRAME_DELAY (42)
#define FRAME_WIDTH (64)
#define FRAME_HEIGHT (64)
#define FRAME_COUNT1 (sizeof(frames1) / sizeof(frames1[0])) //1 for sad
#define FRAME_COUNT2 (sizeof(frames2) / sizeof(frames2[0])) //2 for happy
#define FRAME_COUNT3 (sizeof(frames3) / sizeof(frames3[0])) //3 for watering
int frame = 0;

const byte PROGMEM frames1[][512] = {
  {0,0,0,0,0,0,0,0,0,0,0,0,0,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0,0},
  {0,0,0,0,0,0,0,0,0,0,0,0,0,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0,0},
  {0,0,0,0,0,0,0,0,0,0,0,0,0,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0,0},
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  {0,0,0,0,0,0,0,0,0,0,0,0,0,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0,0}
};

const byte PROGMEM frames2[][512] = {
  {0,0,0,0,0,0,0,0,0,0,0,0,0,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0,0},
  {0,0,0,0,0,0,0,0,0,0,0,0,0,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0,0},
  {0,0,0,0,0,0,0,0,0,0,0,0,0,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0,0},
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  {0,0,0,0,0,0,0,0,0,0,0,0,0,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0,0}
};

const byte PROGMEM frames3[][512] = {
  {0,0,0,0,0,0,0,0,0,0,0,0,0,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0,0},
  {0,0,0,0,0,0,0,0,0,0,0,0,0,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0,0},
  {0,0,0,0,0,0,0,0,0,0,0,0,0,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0,0},
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  {0,0,0,0,0,0,0,0,0,0,0,0,0,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0,0}
};

bool isAudioPlaying = false;

void setup() {
  Serial.begin(9600);
  softwareSerial.begin(9600);
  pinMode(pushButton, INPUT_PULLUP);
  pinMode(ledRed, OUTPUT);
  pinMode(ledGreen, OUTPUT);
  pinMode(relay, OUTPUT);
  pinMode(buzzer, OUTPUT);

  lcd.init();
  lcd.backlight();
  lcd.setCursor(1, 0);
  lcd.print("System Loading");
  for (int a = 0; a <= 15; a++) {
    lcd.setCursor(a, 1);
    lcd.print(".");
    delay(200);
  }
  lcd.clear();

  if(!display.begin(SSD1306_SWITCHCAPVCC, 0x3C)) { 
   Serial.println(("SSD1306 allocation failed"));
     for(;;); // Don't proceed, loop forever
   }
  
  display.display();
  delay(2000);
  display.clearDisplay();

   if (player.begin(softwareSerial)) {
     Serial.println("OK");
  } else {
    Serial.println("Connecting to DFPlayer Mini failed!");
  }
}

void soilMoisture() {
      moistureValue = analogRead(AOUT_PIN);
      int moistureValuePercent= map(moistureValue, airValue, waterValue, 0, 100);
      moistureValuePercent = constrain(moistureValuePercent, 0, 100);
      lcd.setCursor(0, 0);
      lcd.print("Moisture :");
      lcd.print(moistureValuePercent);
      lcd.print("%       ");
      lcd.print(" ");
      delay(500);
  
      int trackToPlay = -1;

      if (moistureValuePercent > 93 ) {
        lcd.setCursor(1, 1);
        lcd.print("Very Wet");
        warnLedGreen();
        oledHappy();
        trackToPlay = 2;
        
      } else if (moistureValuePercent < intervals) {
        lcd.setCursor(1, 1);
        lcd.print("DRY     ");
        warnLedRed();
        oledSad();
        trackToPlay = 1;

      } else if (moistureValuePercent > intervals && moistureValuePercent < 93) {
        lcd.setCursor(1, 1);
        lcd.print("WET        ");
        warnLedGreen();
        trackToPlay = 1;
      }
      if (trackToPlay != -1 && (!isAudioPlaying || trackToPlay != lastPlayedTrack)) {
      player.volume(30);
      player.play(trackToPlay);
      isAudioPlaying = true;
      lastPlayedTrack = trackToPlay;
      }
      if (player.available() && player.readType() == DFPlayerPlayFinished) {
      isAudioPlaying = false;
      }
}

void warnLedRed(){
    digitalWrite(ledGreen, LOW);
    digitalWrite(ledRed, HIGH);
    digitalWrite(buzzer, HIGH);
    delay(700);
    digitalWrite(ledRed, LOW);
    digitalWrite(buzzer, LOW);
    delay(700);
}

void warnLedGreen(){
    digitalWrite(ledGreen,HIGH);
    digitalWrite(buzzer, LOW);  
}


void button() {
  unsigned long currentMillis = millis();
    if (currentMillis - previousMillis >= intervalBtn) { // Check if it's time to read moisture
      previousMillis = currentMillis; // Save the last time moisture was read
      buttonState = digitalRead(pushButton);
  } 
  if (buttonState == LOW) { 
    digitalWrite(relay, LOW);
        Serial.print("mati");
  } else {
    digitalWrite(relay, HIGH);
    Serial.print("nyala");
    //oledWatering();
  }
}

void oledSad(){
  display.clearDisplay();
  display.drawBitmap(32, 0, frames1[frame], FRAME_WIDTH, FRAME_HEIGHT, 1);
  display.display();
  frame = (frame + 1) % FRAME_COUNT1;
  delay(FRAME_DELAY);
}

void oledHappy(){
  display.clearDisplay();
  display.drawBitmap(32, 0, frames2[frame], FRAME_WIDTH, FRAME_HEIGHT, 1);
  display.display();
  frame = (frame + 1) % FRAME_COUNT2;
  delay(FRAME_DELAY);
}

void oledWatering(){
  display.clearDisplay();
  display.drawBitmap(32, 0, frames3[frame], FRAME_WIDTH, FRAME_HEIGHT, 1);
  display.display();
  frame = (frame + 1) % FRAME_COUNT3;
  delay(FRAME_DELAY);
}

void loop(){
  //vTaskDelete(NULL);
}